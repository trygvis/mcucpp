## Kconfig
```kconfig
mainmenu "MCU C++ Configuration"

menu "tinyprintf settings"
  config TINYPRINTF
    bool "Enable tinyprintf"

  if TINYPRINTF

  config TINYPRINTF_PRINTF
    bool "Enable printf() implementation with tinyprintf"
    default y

  config TINYPRINTF_SNPRINTF
    bool "Enable snprintf() implementation with tinyprintf"
    default y

  endif # TINYPRINTF

endmenu

menu "Semihosting settings"
  config SEMIHOSTING
    bool "Enable semihosting"

  if SEMIHOSTING

  config SEMIHOSTING_PUTCHAR
    bool "Enable putchar() implementation with semihosting"
    default y

  config SEMIHOSTING_PUTS
    bool "Enable puts() implementation with semihosting"
    default y

  endif # SEMIHOSTING

endmenu

menu "stdio settings"

choice STDIO_TARGET
    prompt "stdio target"

    config STDIO_TARGET_SEMIHOSTING
        depends on SEMIHOSTING
        bool "Semihosting"

    config STDIO_TARGET_STM32CUBE_UART
        bool "STM32Cube UART"

endchoice

choice
    prompt "STM32Cube UART port"
    depends on STDIO_TARGET_STM32CUBE_UART

    config STDIO_TARGET_STM32CUBE_UART_PORT_1
        bool "Use huart1"

    config STDIO_TARGET_STM32CUBE_UART_PORT_2
        bool "Use huart2"

endchoice

config STDIO_TARGET_STM32CUBE_UART_PORT
    string
    default "huart1" if STDIO_TARGET_STM32CUBE_UART_PORT_1
    default "huart2" if STDIO_TARGET_STM32CUBE_UART_PORT_2

endmenu
```

## config/Kconfig
```kconfig
mainmenu "MCU C++ Configuration"

source chip.config

menu "tinyprintf settings"
  config TINYPRINTF
    bool "Enable tinyprintf"

  if TINYPRINTF

  config TINYPRINTF_PRINTF
    bool "Enable printf() implementation with tinyprintf"
    default y

  config TINYPRINTF_SNPRINTF
    bool "Enable snprintf() implementation with tinyprintf"
    default y

  endif # TINYPRINTF

endmenu

menu "Semihosting settings"
  config SEMIHOSTING
    bool "Enable semihosting"

  if SEMIHOSTING

  config SEMIHOSTING_PUTCHAR
    bool "Enable putchar() implementation with semihosting"
    default y

  config SEMIHOSTING_PUTS
    bool "Enable puts() implementation with semihosting"
    default y

  endif # SEMIHOSTING

endmenu

menu "stdio settings"

config STDIO_ENABLE
    bool "enable stdio target"

choice STDIO_TARGET
    prompt "stdio target"

    depends on STDIO_ENABLE

    config STDIO_TARGET_SEMIHOSTING
        depends on SEMIHOSTING
        bool "Semihosting"

    config STDIO_TARGET_STM32CUBE_UART
        bool "STM32Cube UART"
        depends on CHIP_FAMILY_STM32

    config STDIO_TARGET_NRF_LOG
        bool "Use NRF_LOG macros"
        depends on CHIP_FAMILY_NRF51 || CHIP_FAMILY_NRF52

    config STDIO_TARGET_NRF_UART
        bool "Use nRF5x UART"
        depends on CHIP_FAMILY_NRF51 || CHIP_FAMILY_NRF52

endchoice

choice
    prompt "STM32Cube UART port"
    depends on STDIO_TARGET_STM32CUBE_UART

    config STDIO_TARGET_STM32CUBE_UART_PORT_1
        bool "Use huart1"

    config STDIO_TARGET_STM32CUBE_UART_PORT_2
        bool "Use huart2"

endchoice

config STDIO_TARGET_STM32CUBE_UART_PORT
    string
    depends on CHIP_FAMILY_STM32
    default "huart1" if STDIO_TARGET_STM32CUBE_UART_PORT_1
    default "huart2" if STDIO_TARGET_STM32CUBE_UART_PORT_2
endmenu
```
